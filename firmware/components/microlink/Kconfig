## firmware/components/microlink/Kconfig
```kconfig
menu "MicroLink V2 Configuration"

    config ML_ZERO_COPY_WG
        bool "Enable zero-copy WireGuard receive"
        default n
        help
            Keep the default BSD socket path for this voice device. The
            zero-copy path is available for high-throughput applications.

    config ML_MAX_PEERS
        int "Maximum simultaneous WireGuard peers"
        default 8
        range 1 64
        help
            Active peers are capped at eight for this device.

    config ML_NVS_MAX_PEERS
        int "Maximum cached peers in NVS"
        default 16
        range 16 1024

    config ML_PRIORITY_PEER_IP
        string "Priority peer VPN IP"
        default ""

    config ML_H2_BUFFER_SIZE_KB
        int "HTTP/2 receive buffer size (KB)"
        default 64
        range 64 2048
        help
            64KB is the bounded MapResponse buffer for this device.

    config ML_JSON_BUFFER_SIZE_KB
        int "JSON parse buffer size (KB)"
        default 64
        range 64 2048
        help
            64KB is the bounded cJSON MapResponse buffer for this device.

    config ML_DERP_REGION
        int "Preferred DERP region"
        default 11
        range 1 32
        help
            Tailscale DERP region 11 (São Paulo). This is sent as
            PreferredDERP and used as the fallback when the control plane
            does not provide a home region.

    menu "Credentials"
        comment "Configure secrets only in local sdkconfig or menuconfig."

        config ML_TAILSCALE_AUTH_KEY
            string "Tailscale auth key"
            default ""
            help
                Local-only auth key. Never commit, log, or print its value.

        config ML_DEVICE_NAME
            string "Device hostname"
            default "esp32-hermes"

    endmenu

endmenu
```

## firmware/main/Kconfig.projbuild
```kconfig
menu "ESP32 Voice Agent"

config VOICE_WIFI_PRIMARY_SSID
    string "Primary Wi-Fi SSID"
    default "Ramiro-2.4Ghz"
    help
        Configure in sdkconfig.defaults.local. Never commit the local value.

config VOICE_WIFI_PRIMARY_PASSWORD
    string "Primary Wi-Fi password"
    default ""

config VOICE_WIFI_SECONDARY_SSID
    string "Fallback Wi-Fi SSID"
    default "Rama"

config VOICE_WIFI_SECONDARY_PASSWORD
    string "Fallback Wi-Fi password"
    default ""

config VOICE_BRIDGE_URL
    string "Voice bridge base URL"
    default "https://hermes-server.tailfb789f.ts.net:8443"
    help
        The official remote endpoint. A LAN URL may be supplied only in a local
        sdkconfig override for development.

config VOICE_DEVICE_ID
    string "Device ID"
    default "esp32-voice-01"

config VOICE_DEVICE_TOKEN
    string "Device bearer token"
    default ""
    help
        Configure locally; never commit or log a real token.

config VOICE_BRIDGE_EMBED_LOCAL_CA
    bool "Embed a private/local root CA"
    default n
    help
        Enable for a private PKI. The public Tailscale Funnel endpoint uses the
        ESP-IDF certificate bundle by default.

config VOICE_MAX_RECORDING_SECONDS
    int "Maximum recording duration"
    range 1 30
    default 30

config VOICE_POLL_TIMEOUT_SECONDS
    int "Maximum time to wait for STT, Hermes, and speech"
    range 30 600
    default 180

config VOICE_AUDIO_VOLUME
    int "Initial speaker volume"
    range 0 100
    default 65
    help
        Initial value only. The button persists the current volume in NVS.

endmenu
```

## firmware/sdkconfig.defaults
```kconfig
# Waveshare ESP32-S3-Touch-AMOLED-2.06 hardware defaults.
CONFIG_IDF_TARGET="esp32s3"
CONFIG_ESPTOOLPY_FLASHMODE_QIO=y
CONFIG_ESPTOOLPY_FLASHSIZE_16MB=y
CONFIG_PARTITION_TABLE_CUSTOM=y
CONFIG_PARTITION_TABLE_CUSTOM_FILENAME="partitions.csv"
CONFIG_PARTITION_TABLE_FILENAME="partitions.csv"
CONFIG_COMPILER_OPTIMIZATION_PERF=y
CONFIG_SPIRAM=y
CONFIG_SPIRAM_MODE_OCT=y
CONFIG_SPIRAM_FETCH_INSTRUCTIONS=y
CONFIG_SPIRAM_RODATA=y
CONFIG_SPIRAM_SPEED_80M=y
CONFIG_SPIRAM_MALLOC_ALWAYSINTERNAL=4096
CONFIG_SPIRAM_MALLOC_RESERVE_INTERNAL=65536
CONFIG_ESP_DEFAULT_CPU_FREQ_MHZ_240=y
CONFIG_FREERTOS_HZ=1000
CONFIG_MBEDTLS_CERTIFICATE_BUNDLE=y
CONFIG_LV_FONT_MONTSERRAT_16=y
CONFIG_LV_FONT_MONTSERRAT_20=y
CONFIG_LV_FONT_MONTSERRAT_28=y
CONFIG_LV_THEME_DEFAULT_DARK=y
CONFIG_LV_USE_LOG=y
CONFIG_BSP_DISPLAY_LVGL_BUF_HEIGHT=40
CONFIG_VOICE_BRIDGE_URL="https://hermes-server.tailfb789f.ts.net:8443"
CONFIG_VOICE_WIFI_PRIMARY_SSID="Ramiro-2.4Ghz"
CONFIG_VOICE_WIFI_SECONDARY_SSID="Rama"
```
